## conf/bblayers.conf.sample
```bitbake
# LAYER_CONF_VERSION is increased each time build/conf/bblayers.conf
# changes incompatibly
LCONF_VERSION = "7"

BBPATH = "${TOPDIR}"
BBFILES ?= ""
RDKROOT := "${@os.path.abspath(os.path.dirname(d.getVar('FILE', True)) + '/../..')}"

BBLAYERS ?= " \
  ${RDKROOT}/meta-mng \
  ${@'${RDKROOT}/meta-mng-restricted' if os.path.isfile('${RDKROOT}/meta-mng-restricted/conf/layer.conf') else ''} \
  ${BBLAYERS_BSP} \
  ${BBLAYERS_BSP_IF_AVAILABLE} \
  ${RDKROOT}/openembedded-core/meta \
  ${RDKROOT}/meta-openembedded/meta-oe \
  ${RDKROOT}/meta-openembedded/meta-networking \
  ${RDKROOT}/meta-openembedded/meta-python \
  ${@'${RDKROOT}/meta-gplv2' if os.path.isfile('${RDKROOT}/meta-gplv2/conf/layer.conf') else ''} \
  ${BBLAYERS_IF_AVAILABLE} \
"

BBLAYERS_IF_AVAILABLE = ""

# Machine specific BSP layers
BBLAYERS_BSP = ""
```

## conf/distro/include/init-manager-mdev-busybox.inc
```bitbake
# Use busybox/mdev for system initialization

VIRTUAL-RUNTIME_dev_manager = "busybox-mdev"
VIRTUAL-RUNTIME_login_manager = "busybox"
VIRTUAL-RUNTIME_init_manager = "busybox"
VIRTUAL-RUNTIME_initscripts = "initscripts"

DISTRO_FEATURES_BACKFILL_CONSIDERED += "sysvinit"
```

## conf/distro/include/init-manager-systemd.inc
```bitbake
# Use systemd for system initialization

VIRTUAL-RUNTIME_dev_manager = "udev"
VIRTUAL-RUNTIME_login_manager = "busybox"
VIRTUAL-RUNTIME_init_manager = "systemd"
VIRTUAL-RUNTIME_initscripts = "systemd-compat-units"

DISTRO_FEATURES_BACKFILL_CONSIDERED += "sysvinit"

DISTRO_FEATURES_append = " systemd"

# Avoid pulling in the udev static hwdb by default (note that udev-hwdb is provided by systemd)
BAD_RECOMMENDATIONS += "udev-hwdb"
```

## conf/distro/include/mng-glibc.inc
```bitbake
# ----------------------------------------------------------------------------

# use gold linker for ARM/Intel targets
DISTRO_FEATURES_append_arm = " ld-is-gold"
DISTRO_FEATURES_append_armeb = " ld-is-gold"
DISTRO_FEATURES_append_x86 = " ld-is-gold"

# ----------------------------------------------------------------------------
```

## conf/distro/include/mng-rdkb.inc
```bitbake
# ----------------------------------------------------------------------

# Enable the _broadband over-ride (for compatibility with external meta layers
# only - no local recipes should be relying on it). Note that upstream RDKB
# enables the over-ride via MACHINEOVERRIDES in each individual machine config.
# Enabling globally via DISTROOVERRIDES is a little cleaner.

DISTROOVERRIDES .= ":broadband"

# ----------------------------------------------------------------------

DISTRO_FEATURES_append = " core-net-lib"
DISTRO_FEATURES_append = " ddns_broadband"
DISTRO_FEATURES_append = " dslite"
DISTRO_FEATURES_append = " fcgi"
DISTRO_FEATURES_append = " meshwifi"
DISTRO_FEATURES_append = " multilan"
DISTRO_FEATURES_append = " network_logs"
DISTRO_FEATURES_append = " rdkb_gpon_manager"
DISTRO_FEATURES_append = " rdkb_wan_manager"
DISTRO_FEATURES_append = " sk"
DISTRO_FEATURES_append = " ssam"

# ----------------------------------------------------------------------

CCSP_CONFIG_ARCH ?= ""
CCSP_CONFIG_PLATFORM ?= ""

CCSP_CFLAGS_MACHINE ?= ""

# ----------------------------------------------------------------------

PREFERRED_PROVIDER_hal-cm ?= "hal-cm-generic"
PREFERRED_PROVIDER_hal-dhcpv4c ?= "hal-dhcpv4c-generic"
PREFERRED_PROVIDER_hal-epon ?= "hal-epon-generic"
PREFERRED_PROVIDER_hal-ethsw ?= "hal-ethsw-generic"
PREFERRED_PROVIDER_hal-fwupgrade ?= "hal-fwupgrade-generic"
PREFERRED_PROVIDER_hal-gwprovappabs ?= "hal-gwprovappabs-generic"
PREFERRED_PROVIDER_hal-moca ?= "hal-moca-generic"
PREFERRED_PROVIDER_hal-mso_mgmt ?= "hal-mso-mgmt-generic"
PREFERRED_PROVIDER_hal-mta ?= "hal-mta-generic"
PREFERRED_PROVIDER_hal-platform ?= "hal-platform-generic"
PREFERRED_PROVIDER_hal-vlan ?= "hal-vlan-generic"
PREFERRED_PROVIDER_hal-wifi ?= "hal-wifi-generic"

# ----------------------------------------------------------------------
```

## conf/distro/include/mng-security-flags.inc
```bitbake
# ----------------------------------------------------------------------------
#
# Enable extra CFLAGS which have security benefits.
#
# For reference, see:
#
#   - https://wiki.debian.org/Hardening
#   - https://idea.popcount.org/2013-08-15-fortify_source/
#   - https://outflux.net/blog/archives/2014/01/27/fstack-protector-strong
#
# ----------------------------------------------------------------------------

SECURITY_STACK_PROTECTOR ?= "-fstack-protector-strong"

SECURITY_STACK_PROTECTOR_pn-gcc-runtime = ""
SECURITY_STACK_PROTECTOR_pn-glibc = ""
SECURITY_STACK_PROTECTOR_pn-glibc-testsuite = ""

# Disabling -fstack-protector-strong for dbus is required to avoid hangs etc
# (e.g. dmcli commands hang for 60 seconds before returning). The root cause is
# not fully understood yet but either related to bugs introduced into dbus by
# the Comcast RDKB patches or by the way in which RDKB misuses dbus APIs (which
# also means dbus can not be build with internal error checking enabled, see
# the dbus .bbappend). Fixme: to be reviewed.

SECURITY_STACK_PROTECTOR_pn-dbus = ""

# ----------------------------------------------------------------------------

# The meta-oe and meta-virtualization layer config files include over-rides
# which force SECURITY_CFLAGS to SECURITY_NO_PIE_CFLAGS, so even though we
# don't use it directly here, SECURITY_NO_PIE_CFLAGS still needs to be defined.

SECURITY_NO_PIE_CFLAGS = "${SECURITY_STACK_PROTECTOR} ${@oe.utils.conditional('DEBUG_BUILD','1','','-D_FORTIFY_SOURCE=2',d)}"

SECURITY_CFLAGS = "${SECURITY_NO_PIE_CFLAGS}"

SECURITY_LDFLAGS = "${SECURITY_STACK_PROTECTOR} -Wl,-z,relro,-z,now"

# ----------------------------------------------------------------------------

SECURITY_LDFLAGS_pn-sysklogd = ""
SECURITY_LDFLAGS_pn-valgrind = ""

# ----------------------------------------------------------------------------

TARGET_CFLAGS_append_class-target = " ${SECURITY_CFLAGS}"
TARGET_LDFLAGS_append_class-target = " ${SECURITY_LDFLAGS}"

# ----------------------------------------------------------------------------
```

## conf/distro/include/mng-sstate.inc
```bitbake
# Use the LSB_DISTRO_ADJUST hook to make Linux Mint appear to be Ubuntu (so
# that sstate cache from an Ubuntu system can be reused by a Linux Mint system
# directly, without needing to e.g. symlink subdirectories under sstate-cache).
#
# Note that the LinuxMint distro ID can be either capitalised or lower case,
# depending on the exact version of LinuxMint and whether the ID is fetched
# from /etc/os-release or from "lsb_release -ir". Try to handle all cases.

def lsb_distro_adjust(distro_id, ver):

    if (distro_id.lower() == 'linuxmint'):
        if ver in [ '17', '17.1', '17.2', '17.3' ]:
            distro_id = 'Ubuntu'
            ver = '14.04'
        if ver in [ '18', '18.1', '18.2', '18.3' ]:
            distro_id = 'Ubuntu'
            ver = '16.04'
        if ver in [ '19', '19.1', '19.2', '19.3' ]:
            distro_id = 'Ubuntu'
            ver = '18.04'
        if ver in [ '20', '20.1', '20.2', '20.3' ]:
            distro_id = 'Ubuntu'
            ver = '20.04'

    return distro_id, ver

LSB_DISTRO_ADJUST = "lsb_distro_adjust"
```

## conf/distro/include/mng-versions-local.inc
```bitbake
# ----------------------------------------------------------------------------

RDK_RELEASE ?= "8888"

LGI_RDKB_GIT ?= "git://${@os.path.normpath("${COREBASE}/../src")}"
LGI_RDKB_GIT_SUFFIX ?= ""
LGI_RDKB_GIT_PROTOCOL ?= "file"
LGI_RDKB_GIT_EXTRAOPT ?= ";usehead=1"

# ----------------------------------------------------------------------------

# In most cases the UI repos will come from the same place as the RDKB repos,
# but use separate definitions to handle corner cases where they do not.

LGI_UI_GIT ?= "git://${@os.path.normpath("${COREBASE}/../src")}"
LGI_UI_GIT_SUFFIX ?= ""
LGI_UI_GIT_PROTOCOL ?= "file"
LGI_UI_GIT_EXTRAOPT ?= ";usehead=1"

WEBUI_OFW_REPONAME ?= "webui-ofw"

# ----------------------------------------------------------------------------
#
# Even though the protocol is "file" (ie the source repo is already available
# in the local filesystem) the git fetcher will still create a clone of the
# source repo in the OE downloads directory. The repo name within the downloads
# directory will be based on the absolute path of the source repo, for example:
#
#   Original source repo       : /home/user/build-123/src/foo
#   Path of clone in downloads : ${DL_DIR}/git2/home.user.build-123.src.foo
#
# If the source repos are part of the directory structure created by
# "repo init ; repo sync" then their absolute path will change whenever
# "repo init ; repo sync" is run in a new directory. To avoid filling downloads
# with multiple clones of the local source repos, force the fetcher to create
# the clones under BASE_WORKDIR (ie under tmp) instead of the default downloads
# directory. They will then be automatically removed whenever tmp is deleted.
#
# ----------------------------------------------------------------------------

DL_DIR_pn-breakpad-wrapper              = "${BASE_WORKDIR}/${MULTIMACH_TARGET_SYS}/${PN}/downloads"
DL_DIR_pn-ccsp-cm-agent                 = "${BASE_WORKDIR}/${MULTIMACH_TARGET_SYS}/${PN}/downloads"
DL_DIR_pn-ccsp-common-library           = "${BASE_WORKDIR}/${MULTIMACH_TARGET_SYS}/${PN}/downloads"
DL_DIR_pn-ccsp-common-library-native    = "${BASE_WORKDIR}/${MULTIMACH_TARGET_SYS}/${PN}/downloads"
DL_DIR_pn-ccsp-cr                       = "${BASE_WORKDIR}/${MULTIMACH_TARGET_SYS}/${PN}/downloads"
DL_DIR_pn-ccsp-dmcli                    = "${BASE_WORKDIR}/${MULTIMACH_TARGET_SYS}/${PN}/downloads"
DL_DIR_pn-ccsp-epon-agent               = "${BASE_WORKDIR}/${MULTIMACH_TARGET_SYS}/${PN}/downloads"
DL_DIR_pn-ccsp-eth-agent                = "${BASE_WORKDIR}/${MULTIMACH_TARGET_SYS}/${PN}/downloads"
DL_DIR_pn-ccsp-gwprovapp                = "${BASE_WORKDIR}/${MULTIMACH_TARGET_SYS}/${PN}/downloads"
DL_DIR_pn-ccsp-gwprovapp-epon           = "${BASE_WORKDIR}/${MULTIMACH_TARGET_SYS}/${PN}/downloads"
DL_DIR_pn-ccsp-gwprovapp-ethwan         = "${BASE_WORKDIR}/${MULTIMACH_TARGET_SYS}/${PN}/downloads"
DL_DIR_pn-ccsp-home-security            = "${BASE_WORKDIR}/${MULTIMACH_TARGET_SYS}/${PN}/downloads"
DL_DIR_pn-ccsp-hotspot                  = "${BASE_WORKDIR}/${MULTIMACH_TARGET_SYS}/${PN}/downloads"
DL_DIR_pn-ccsp-hotspot-kmod             = "${BASE_WORKDIR}/${MULTIMACH_TARGET_SYS}/${PN}/downloads"
DL_DIR_pn-ccsp-jse                      = "${BASE_WORKDIR}/${MULTIMACH_TARGET_SYS}/${PN}/downloads"
DL_DIR_pn-ccsp-lm-lite                  = "${BASE_WORKDIR}/${MULTIMACH_TARGET_SYS}/${PN}/downloads"
DL_DIR_pn-ccsp-misc                     = "${BASE_WORKDIR}/${MULTIMACH_TARGET_SYS}/${PN}/downloads"
DL_DIR_pn-ccsp-moca                     = "${BASE_WORKDIR}/${MULTIMACH_TARGET_SYS}/${PN}/downloads"
DL_DIR_pn-ccsp-mta-agent                = "${BASE_WORKDIR}/${MULTIMACH_TARGET_SYS}/${PN}/downloads"
DL_DIR_pn-ccsp-p-and-m                  = "${BASE_WORKDIR}/${MULTIMACH_TARGET_SYS}/${PN}/downloads"
DL_DIR_pn-ccsp-psm                      = "${BASE_WORKDIR}/${MULTIMACH_TARGET_SYS}/${PN}/downloads"
DL_DIR_pn-ccsp-snmp-pa                  = "${BASE_WORKDIR}/${MULTIMACH_TARGET_SYS}/${PN}/downloads"
DL_DIR_pn-ccsp-tr069-pa                 = "${BASE_WORKDIR}/${MULTIMACH_TARGET_SYS}/${PN}/downloads"
DL_DIR_pn-ccsp-wifi-agent               = "${BASE_WORKDIR}/${MULTIMACH_TARGET_SYS}/${PN}/downloads"
DL_DIR_pn-ccsp-xdns                     = "${BASE_WORKDIR}/${MULTIMACH_TARGET_SYS}/${PN}/downloads"
DL_DIR_pn-core-net-lib                  = "${BASE_WORKDIR}/${MULTIMACH_TARGET_SYS}/${PN}/downloads"
DL_DIR_pn-dca                           = "${BASE_WORKDIR}/${MULTIMACH_TARGET_SYS}/${PN}/downloads"
DL_DIR_pn-dcmjsonparser                 = "${BASE_WORKDIR}/${MULTIMACH_TARGET_SYS}/${PN}/downloads"
DL_DIR_pn-hal-cm-generic                = "${BASE_WORKDIR}/${MULTIMACH_TARGET_SYS}/${PN}/downloads"
DL_DIR_pn-hal-dhcpv4c-generic           = "${BASE_WORKDIR}/${MULTIMACH_TARGET_SYS}/${PN}/downloads"
DL_DIR_pn-hal-epon-generic              = "${BASE_WORKDIR}/${MULTIMACH_TARGET_SYS}/${PN}/downloads"
DL_DIR_pn-hal-ethsw-generic             = "${BASE_WORKDIR}/${MULTIMACH_TARGET_SYS}/${PN}/downloads"
DL_DIR_pn-hal-fwupgrade-generic         = "${BASE_WORKDIR}/${MULTIMACH_TARGET_SYS}/${PN}/downloads"
DL_DIR_pn-hal-gwprovappabs-generic      = "${BASE_WORKDIR}/${MULTIMACH_TARGET_SYS}/${PN}/downloads"
DL_DIR_pn-hal-moca-generic              = "${BASE_WORKDIR}/${MULTIMACH_TARGET_SYS}/${PN}/downloads"
DL_DIR_pn-hal-mso-mgmt-generic          = "${BASE_WORKDIR}/${MULTIMACH_TARGET_SYS}/${PN}/downloads"
DL_DIR_pn-hal-mta-generic               = "${BASE_WORKDIR}/${MULTIMACH_TARGET_SYS}/${PN}/downloads"
DL_DIR_pn-hal-platform-generic          = "${BASE_WORKDIR}/${MULTIMACH_TARGET_SYS}/${PN}/downloads"
DL_DIR_pn-hal-vlan-generic              = "${BASE_WORKDIR}/${MULTIMACH_TARGET_SYS}/${PN}/downloads"
DL_DIR_pn-hal-wifi-generic              = "${BASE_WORKDIR}/${MULTIMACH_TARGET_SYS}/${PN}/downloads"
DL_DIR_pn-halinterface                  = "${BASE_WORKDIR}/${MULTIMACH_TARGET_SYS}/${PN}/downloads"
DL_DIR_pn-ipoe-health-check             = "${BASE_WORKDIR}/${MULTIMACH_TARGET_SYS}/${PN}/downloads"
DL_DIR_pn-json-hal-lib                  = "${BASE_WORKDIR}/${MULTIMACH_TARGET_SYS}/${PN}/downloads"
DL_DIR_pn-libsyswrapper                 = "${BASE_WORKDIR}/${MULTIMACH_TARGET_SYS}/${PN}/downloads"
DL_DIR_pn-libunpriv                     = "${BASE_WORKDIR}/${MULTIMACH_TARGET_SYS}/${PN}/downloads"
DL_DIR_pn-mesh-agent                    = "${BASE_WORKDIR}/${MULTIMACH_TARGET_SYS}/${PN}/downloads"
DL_DIR_pn-notify-comp                   = "${BASE_WORKDIR}/${MULTIMACH_TARGET_SYS}/${PN}/downloads"
DL_DIR_pn-rbus                          = "${BASE_WORKDIR}/${MULTIMACH_TARGET_SYS}/${PN}/downloads"
DL_DIR_pn-rdk-fwupgrade-manager         = "${BASE_WORKDIR}/${MULTIMACH_TARGET_SYS}/${PN}/downloads"
DL_DIR_pn-rdk-logger                    = "${BASE_WORKDIR}/${MULTIMACH_TARGET_SYS}/${PN}/downloads"
DL_DIR_pn-rdk-vlanmanager               = "${BASE_WORKDIR}/${MULTIMACH_TARGET_SYS}/${PN}/downloads"
DL_DIR_pn-rdk-wanmanager                = "${BASE_WORKDIR}/${MULTIMACH_TARGET_SYS}/${PN}/downloads"
DL_DIR_pn-rdkgponmanager                = "${BASE_WORKDIR}/${MULTIMACH_TARGET_SYS}/${PN}/downloads"
DL_DIR_pn-rdklist                       = "${BASE_WORKDIR}/${MULTIMACH_TARGET_SYS}/${PN}/downloads"
DL_DIR_pn-rdktelcovoicemanager          = "${BASE_WORKDIR}/${MULTIMACH_TARGET_SYS}/${PN}/downloads"
DL_DIR_pn-sysint-broadband              = "${BASE_WORKDIR}/${MULTIMACH_TARGET_SYS}/${PN}/downloads"
DL_DIR_pn-syslog-helper                 = "${BASE_WORKDIR}/${MULTIMACH_TARGET_SYS}/${PN}/downloads"
DL_DIR_pn-telemetry                     = "${BASE_WORKDIR}/${MULTIMACH_TARGET_SYS}/${PN}/downloads"
DL_DIR_pn-test-and-diagnostic           = "${BASE_WORKDIR}/${MULTIMACH_TARGET_SYS}/${PN}/downloads"
DL_DIR_pn-utopia                        = "${BASE_WORKDIR}/${MULTIMACH_TARGET_SYS}/${PN}/downloads"
DL_DIR_pn-webconfig-framework           = "${BASE_WORKDIR}/${MULTIMACH_TARGET_SYS}/${PN}/downloads"

DL_DIR_pn-rest-backend                  = "${BASE_WORKDIR}/${MULTIMACH_TARGET_SYS}/${PN}/downloads"
DL_DIR_pn-webui-ofw                     = "${BASE_WORKDIR}/${MULTIMACH_TARGET_SYS}/${PN}/downloads"

# ----------------------------------------------------------------------------
```

## conf/distro/include/mng-versions-ofw-2009.inc
```bitbake
# ----------------------------------------------------------------------------

RDK_RELEASE ?= "2009"

LGI_RDKB_GIT ?= "git://github.com/lgirdk"
LGI_RDKB_GIT_PROTOCOL ?= "https"
LGI_RDKB_GIT_BRANCH ?= "ofw-2009"

BB_SRCREV_POLICY ?= "cache"

# ----------------------------------------------------------------------------
```
