## conf/distro/include/mng-versions-ofw-2010.inc
```bitbake
# ----------------------------------------------------------------------------

RDK_RELEASE ?= "2010"

LGI_RDKB_GIT ?= "git://github.com/lgirdk"
LGI_RDKB_GIT_PROTOCOL ?= "https"
LGI_RDKB_GIT_BRANCH ?= "ofw-2010"

BB_SRCREV_POLICY ?= "cache"

# ----------------------------------------------------------------------------
```

## conf/distro/include/mng-versions-ofw-2101.inc
```bitbake
# ----------------------------------------------------------------------------

RDK_RELEASE ?= "2101"

LGI_RDKB_GIT ?= "git://github.com/lgirdk"
LGI_RDKB_GIT_SUFFIX ?= ".git"
LGI_RDKB_GIT_PROTOCOL ?= "https"
LGI_RDKB_GIT_EXTRAOPT ?= ";branch=ofw-2101"

BB_SRCREV_POLICY ?= "cache"

# ----------------------------------------------------------------------------
```

## conf/distro/include/mng-versions-ofw-2102.inc
```bitbake
# ----------------------------------------------------------------------------

RDK_RELEASE ?= "2102"

LGI_RDKB_GIT ?= "git://github.com/lgirdk"
LGI_RDKB_GIT_SUFFIX ?= ".git"
LGI_RDKB_GIT_PROTOCOL ?= "https"
LGI_RDKB_GIT_EXTRAOPT ?= ";branch=ofw-2102"

BB_SRCREV_POLICY ?= "cache"

# ----------------------------------------------------------------------------
```

## conf/distro/include/mng-versions-ofw-2104.inc
```bitbake
# ----------------------------------------------------------------------------

RDK_RELEASE ?= "2104"

LGI_RDKB_GIT ?= "git://github.com/lgirdk"
LGI_RDKB_GIT_SUFFIX ?= ".git"
LGI_RDKB_GIT_PROTOCOL ?= "https"
LGI_RDKB_GIT_EXTRAOPT ?= ";branch=ofw-2104"

BB_SRCREV_POLICY ?= "cache"

# ----------------------------------------------------------------------------
```

## conf/distro/include/mng-versions-ofw.inc
```bitbake
# ----------------------------------------------------------------------------

RDK_RELEASE ?= "9999"

LGI_RDKB_GIT ?= "git://github.com/lgirdk"
LGI_RDKB_GIT_SUFFIX ?= ".git"
LGI_RDKB_GIT_PROTOCOL ?= "https"
LGI_RDKB_GIT_EXTRAOPT ?= ";branch=ofw"

# ----------------------------------------------------------------------------

LGI_UI_GIT ?= "git://github.com/lgirdk"
LGI_UI_GIT_SUFFIX ?= ".git"
LGI_UI_GIT_PROTOCOL ?= "ssh"
LGI_UI_GIT_EXTRAOPT ?= ";branch=ofw"

WEBUI_OFW_REPONAME ?= "webui-ofw"

# ----------------------------------------------------------------------------

BB_SRCREV_POLICY ?= "cache"

# ----------------------------------------------------------------------------
```

## conf/distro/mng.conf
```bitbake
DISTRO = "mng"
DISTRO_NAME = "Mercury Next Generation"
DISTRO_VERSION = "1.3"

TARGET_VENDOR = "-ofw"

SDK_VENDOR = "-ofwsdk"
SDK_VERSION := "${@'${DISTRO_VERSION}'.replace('snapshot-${DATE}','snapshot')}"
SDK_NAME = "${DISTRO}-${PRODUCT_NAME}-${TUNE_PKGARCH}"

# Ideally SDKPATH should not be set anymore, but for now keep
# setting it for backwards compatibility with OE 3.0 and earlier.
# See oe-core: 33a5714592 sdk: Decouple default install path from built in path

SDKPATH = "/opt/${DISTRO}/${PRODUCT_NAME}"
SDKPATHINSTALL = "/opt/${DISTRO}/${PRODUCT_NAME}"

PRODUCT_NAME ?= "${MACHINE}"

MAINTAINER = "Andre McCurdy <armccurdy@gmail.com>"

INCOMPATIBLE_LICENSE = "GPLv3.0 GPLv3 GPL-3.0 GPLv3+"
INCOMPATIBLE_LICENSE += "LGPLv3.0 LGPLv3 LGPL-3.0 LGPLv3+"
INCOMPATIBLE_LICENSE += "AGPLv3.0 AGPLv3 AGPL-3.0 AGPLv3+"

# Allow a few selected GPLv3 packages (for use in local debug builds only).
WHITELIST_GPL-3.0 = "gdb"

IMAGE_LINGUAS = ""
ENABLE_BINARY_LOCALE_GENERATION = "0"

# Temp workaround for warnings seen when building SDKs and toolchains.
INSANE_SKIP_glibc-locale = "installed-vs-shipped"

USE_NLS = "no"

MODULE_TARBALL_DEPLOY = "0"

KERNEL_PACKAGE_NAME = "kernel"

# Prevent kernel being included in rootfs images
RDEPENDS_${KERNEL_PACKAGE_NAME}-base = ""

TOOLCHAIN ?= "gcc"

TCLIBC ?= "glibc"

TCLIBCAPPEND = ""

INIT_MANAGER ?= "mdev-busybox"

QEMU_TARGETS = "arm armeb i386 x86_64"

MIRRORS_PRIVATE ?= ""

# ----------------------------------------------------------------------------

# Optimise for size by default, but platforms which don't have a problem with
# code size should over-ride by setting OPTIMIZE_DEFAULT to -O2 in their
# machine configs.

OPTIMIZE_DEFAULT ?= "-Os"

OPTIMIZE_DEFAULT_pn-bash = "-O2"
OPTIMIZE_DEFAULT_pn-glibc = "-O2"
OPTIMIZE_DEFAULT_pn-glibc-initial = "-O2"
OPTIMIZE_DEFAULT_pn-nativesdk-glibc = "-O2"
OPTIMIZE_DEFAULT_pn-nativesdk-glibc-initial = "-O2"
OPTIMIZE_DEFAULT_pn-musl = "-O2"
OPTIMIZE_DEFAULT_pn-openssl = "-O2"
OPTIMIZE_DEFAULT_pn-tinymembench = "-O2"

FULL_OPTIMIZATION = "${OPTIMIZE_DEFAULT} -pipe ${DEBUG_FLAGS}"

# ----------------------------------------------------------------------------

# By default, "version-going-backwards" is reported as an error.
# However we disable the test completely, since we don't care about package
# feeds and version numbers which differ only in their git revisions often do
# appear to go backwards.
ERROR_QA_remove = "version-going-backwards"
# WARN_QA_append = " version-going-backwards"

# ----------------------------------------------------------------------------

BB_DANGLINGAPPENDS_WARNONLY = "true"

# ----------------------------------------------------------------------------

DISTRO_FEATURES_BACKFILL_CONSIDERED = "pulseaudio bluez5 gobject-introspection-data ldconfig"

DISTRO_FEATURES_remove = "alsa bluetooth ext2 irda pcmcia usbgadget usbhost wifi nfs zeroconf 3g nfc x11 vfat"

# Before the ldconfig distro feature was added in OE 2.3, the same functionality
# was controlled via USE_LDCONFIG. Setting USE_LDCONFIG to 0 in OE 2.2 and earlier
# is equivalent to disabling the ldconfig distro feature in OE 2.3 and later.

USE_LDCONFIG = "0"

# Clear LDCONFIGDEPEND to avoid openembedded-core/meta/lib/oe/rootfs.py running
# ldconfig to create /etc/ld.so.cache as part of creating the rootfs. This should
# really be fixed upstream so that running ldconfig is controlled by the ldconfig
# distro feature, but until then we need to clear LDCONFIGDEPEND explicitly.

LDCONFIGDEPEND = ""

# ----------------------------------------------------------------------------

# gmp 4.2.1 is the last version released as LGPLv2
# nettle 2.7.1 is the last version released as LGPLv2
# gnutls 3.3.x is the last branch which supports nettle 2.7.1
PREFERRED_VERSION_gmp = "4.2.1"
PREFERRED_VERSION_nettle = "2.7.1"
PREFERRED_VERSION_gnutls = "3.3.%"

# Use gdb's bundled version of readline (avoids using the ancient version from meta-gplv2)
PACKAGECONFIG_remove_pn-gdb = "readline"

# ----------------------------------------------------------------------------

PREFERRED_VERSION_openssl ?= "1.1.%"

# ----------------------------------------------------------------------------

require include/mng-${TOOLCHAIN}.inc
require include/mng-${TCLIBC}.inc
require include/mng-security-flags.inc
require include/mng-sstate.inc
require include/mng-rdkb.inc

require include/init-manager-${INIT_MANAGER}.inc

# ----------------------------------------------------------------------------

MNG_VERSIONS ?= "local"

require include/mng-versions-${MNG_VERSIONS}.inc

# ----------------------------------------------------------------------------
```

## conf/layer.conf
```bitbake
# We have a conf and classes directory, add to BBPATH
BBPATH .= ":${LAYERDIR}"

# We have recipes-* directories, add to BBFILES
BBFILES += "${LAYERDIR}/recipes-*/*/*.bb \
            ${LAYERDIR}/recipes-*/*/*.bbappend"

BBFILE_COLLECTIONS += "meta-mng"
BBFILE_PATTERN_meta-mng = "^${LAYERDIR}/"
BBFILE_PRIORITY_meta-mng = "14"

LAYERDEPENDS_meta-mng = "core"
LAYERSERIES_COMPAT_meta-mng = "warrior zeus"
```

## conf/machine/exm-qemuarm-clang.conf
```bitbake
# ----------------------------------------------------------------------
#@TYPE: Machine
#@NAME: exm-qemuarm-clang
#@NEEDED_BSPLAYERS: meta-clang
#@RECOMMENDED_BSPLAYERS:
#@DESCRIPTION: EXample Machine derived from qemuarm
# ----------------------------------------------------------------------

require exm-qemuarm.conf

TOOLCHAIN = "clang"
```

## conf/machine/exm-qemuarm-musl.conf
```bitbake
# ----------------------------------------------------------------------
#@TYPE: Machine
#@NAME: exm-qemuarm-musl
#@NEEDED_BSPLAYERS:
#@RECOMMENDED_BSPLAYERS:
#@DESCRIPTION: EXample Machine derived from qemuarm
# ----------------------------------------------------------------------

require exm-qemuarm.conf

TCLIBC = "musl"
```

## conf/machine/exm-qemuarm-systemd.conf
```bitbake
# ----------------------------------------------------------------------
#@TYPE: Machine
#@NAME: exm-qemuarm-systemd
#@NEEDED_BSPLAYERS:
#@RECOMMENDED_BSPLAYERS:
#@DESCRIPTION: EXample Machine derived from qemuarm
# ----------------------------------------------------------------------

require exm-qemuarm.conf

INIT_MANAGER = "systemd"
```

## conf/machine/exm-qemuarm.conf
```bitbake
# ----------------------------------------------------------------------
#@TYPE: Machine
#@NAME: exm-qemuarm
#@NEEDED_BSPLAYERS:
#@RECOMMENDED_BSPLAYERS:
#@DESCRIPTION: EXample Machine derived from qemuarm
# ----------------------------------------------------------------------

require conf/machine/qemuarm.conf

MACHINEOVERRIDES .= ":qemuarm"

SERIAL_CONSOLES = "115200;ttyAMA0"

IMAGE_FSTYPES += "files"

# ----------------------------------------------------------------------

CCSP_CONFIG_ARCH = "--with-ccsp-arch=arm"
CCSP_CONFIG_PLATFORM = "--with-ccsp-platform=bcm"

# Note that _COSA_INTEL_USG_ARM_ may have been a SOC specific option
# at one point, but it's defined by default in upstream ccsp_common.inc
# and non-Intel platforms have come to rely on it being defined?

CCSP_CFLAGS_MACHINE = "-D_COSA_INTEL_USG_ARM_ -D_COSA_BCM_ARM_"

# ----------------------------------------------------------------------
```

## conf/machine/exm-qemux86-clang.conf
```bitbake
# ----------------------------------------------------------------------
#@TYPE: Machine
#@NAME: exm-qemux86-clang
#@NEEDED_BSPLAYERS: meta-clang
#@RECOMMENDED_BSPLAYERS:
#@DESCRIPTION: EXample Machine derived from qemux86
# ----------------------------------------------------------------------

require exm-qemux86.conf

TOOLCHAIN = "clang"
```

## conf/machine/exm-qemux86-musl.conf
```bitbake
# ----------------------------------------------------------------------
#@TYPE: Machine
#@NAME: exm-qemux86-musl
#@NEEDED_BSPLAYERS:
#@RECOMMENDED_BSPLAYERS:
#@DESCRIPTION: EXample Machine derived from qemux86
# ----------------------------------------------------------------------

require exm-qemux86.conf

TCLIBC = "musl"
```

## conf/machine/exm-qemux86-systemd.conf
```bitbake
# ----------------------------------------------------------------------
#@TYPE: Machine
#@NAME: exm-qemux86-systemd
#@NEEDED_BSPLAYERS:
#@RECOMMENDED_BSPLAYERS:
#@DESCRIPTION: EXample Machine derived from qemux86
# ----------------------------------------------------------------------

require exm-qemux86.conf

INIT_MANAGER = "systemd"
```

## conf/machine/exm-qemux86.conf
```bitbake
# ----------------------------------------------------------------------
#@TYPE: Machine
#@NAME: exm-qemux86
#@NEEDED_BSPLAYERS:
#@RECOMMENDED_BSPLAYERS:
#@DESCRIPTION: EXample Machine derived from qemux86
# ----------------------------------------------------------------------

require conf/machine/qemux86.conf

MACHINEOVERRIDES .= ":qemux86"

KMACHINE_qemux86 = "qemux86"

IMAGE_FSTYPES += "files"

# ----------------------------------------------------------------------

CCSP_CONFIG_ARCH = "--with-ccsp-arch=arm"
CCSP_CONFIG_PLATFORM = "--with-ccsp-platform=bcm"

# Note that _COSA_INTEL_USG_ARM_ may have been a SOC specific option
# at one point, but it's defined by default in upstream ccsp_common.inc
# and non-Intel platforms have come to rely on it being defined?

CCSP_CFLAGS_MACHINE = "-D_COSA_INTEL_USG_ARM_ -D_COSA_BCM_ARM_"

# ----------------------------------------------------------------------
```
